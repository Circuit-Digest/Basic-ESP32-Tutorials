#include <Wire.h>
#include <Adafruit_GFX.h>
#include <Adafruit_SSD1306.h>
#include <SPI.h>
#include <Bitcraze_PMW3901.h>

// OLED Display setup
#define SCREEN_WIDTH 128
#define SCREEN_HEIGHT 64
Adafruit_SSD1306 display(SCREEN_WIDTH, SCREEN_HEIGHT, &Wire, -1);

// PMW3901 Sensor setup
#define CS_PIN 5  // Chip Select Pin for PMW3901
Bitcraze_PMW3901 flow(CS_PIN);

const unsigned char Start_icon [] PROGMEM = {
	0x00, 0x00, 0x00, 0x00, 0x00, 0x00, 0x00, 0x00, 0x3f, 0xfc, 0x00, 0x00, 0x00, 0x01, 0xff, 0xff, 
	0x80, 0x00, 0x00, 0x07, 0xff, 0xff, 0xe0, 0x00, 0x00, 0x1f, 0xff, 0xff, 0xf8, 0x00, 0x00, 0x3f, 
	0xe0, 0x07, 0xfc, 0x00, 0x00, 0xff, 0x00, 0x00, 0xff, 0x00, 0x01, 0xfc, 0x00, 0x00, 0x3f, 0x80, 
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	0xff, 0xff, 0x80, 0x00, 0x00, 0x00, 0x3f, 0xfc, 0x00, 0x00, 0x00, 0x00, 0x00, 0x00, 0x00, 0x00
};

const unsigned char LEFT_arrow [] PROGMEM = {
	0x00, 0x00, 0x00, 0x00, 0x00, 0x00, 0x00, 0x00, 0x00, 0x00, 0x00, 0x00, 0x00, 0x00, 0x00, 0x00, 
	0x00, 0x00, 0x00, 0x00, 0x00, 0x00, 0x00, 0x00, 0x00, 0x00, 0x00, 0x00, 0x00, 0x00, 0x00, 0x00, 
	0x00, 0x00, 0x00, 0x00, 0x00, 0x00, 0x40, 0x00, 0x00, 0x00, 0x00, 0x00, 0xc0, 0x00, 0x00, 0x00, 
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	0x00, 0x00, 0x00, 0x00, 0x00, 0x00, 0x00, 0x00, 0x00, 0x00, 0x00, 0x00, 0x00, 0x00, 0x00, 0x00
};

const unsigned char UP_arrow [] PROGMEM = {
	0x00, 0x00, 0x03, 0x80, 0x00, 0x00, 0x00, 0x00, 0x07, 0xc0, 0x00, 0x00, 0x00, 0x00, 0x0f, 0xe0, 
	0x00, 0x00, 0x00, 0x00, 0x1f, 0xf0, 0x00, 0x00, 0x00, 0x00, 0x3f, 0xf8, 0x00, 0x00, 0x00, 0x00, 
	0x7f, 0xfc, 0x00, 0x00, 0x00, 0x00, 0xff, 0xfe, 0x00, 0x00, 0x00, 0x01, 0xff, 0xff, 0x00, 0x00, 
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	0x3f, 0xfc, 0x00, 0x00, 0x00, 0x00, 0x3f, 0xfc, 0x00, 0x00, 0x00, 0x00, 0x3f, 0xfc, 0x00, 0x00
};

const unsigned char RIGHT_arrow [] PROGMEM = {
	0x00, 0x00, 0x00, 0x00, 0x00, 0x00, 0x00, 0x00, 0x00, 0x00, 0x00, 0x00, 0x00, 0x00, 0x00, 0x00, 
	0x00, 0x00, 0x00, 0x00, 0x00, 0x00, 0x00, 0x00, 0x00, 0x00, 0x00, 0x00, 0x00, 0x00, 0x00, 0x00, 
	0x00, 0x00, 0x00, 0x00, 0x00, 0x00, 0x00, 0x02, 0x00, 0x00, 0x00, 0x00, 0x00, 0x03, 0x00, 0x00, 
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	0x00, 0x00, 0x00, 0x00, 0x00, 0x00, 0x00, 0x00, 0x00, 0x00, 0x00, 0x00, 0x00, 0x00, 0x00, 0x00
};

const unsigned char DOWN_arrow [] PROGMEM = {
	0x00, 0x00, 0x3f, 0xfc, 0x00, 0x00, 0x00, 0x00, 0x3f, 0xfc, 0x00, 0x00, 0x00, 0x00, 0x3f, 0xfc, 
	0x00, 0x00, 0x00, 0x00, 0x3f, 0xfc, 0x00, 0x00, 0x00, 0x00, 0x3f, 0xfc, 0x00, 0x00, 0x00, 0x00, 
	0x3f, 0xfc, 0x00, 0x00, 0x00, 0x00, 0x3f, 0xfc, 0x00, 0x00, 0x00, 0x00, 0x3f, 0xfc, 0x00, 0x00, 
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	0x07, 0xf0, 0x00, 0x00, 0x00, 0x00, 0x03, 0xe0, 0x00, 0x00, 0x00, 0x00, 0x01, 0xc0, 0x00, 0x00
};



// Arrow width & height
#define ARROW_WIDTH 48
#define ARROW_HEIGHT 48

// Store last movement direction
String lastMovement = "No Movement";
const unsigned char* lastArrow = nullptr;

void updateDisplay() {
    display.clearDisplay();
    // Center the arrow
    int x = (SCREEN_WIDTH - ARROW_WIDTH) / 2;
    int y = (SCREEN_HEIGHT - ARROW_HEIGHT) / 2;

    if (lastArrow) {
        display.drawBitmap(40, 8, lastArrow, ARROW_WIDTH, ARROW_HEIGHT, WHITE);
    }
    display.display();
}

void setup() {
    Serial.begin(115200);
    
    // Initialize OLED
    if (!display.begin(SSD1306_SWITCHCAPVCC, 0x3C)) {
        Serial.println("SSD1306 allocation failed");
        while (1);
    }

    // Initialize PMW3901
    SPI.begin();
    if (!flow.begin()) {
        Serial.println("PMW3901 Initialization failed!");
        display.clearDisplay();
        display.setTextColor(WHITE);
        display.setCursor(10, 25);
        display.println("Sensor Fail!");
        display.display();
        while (1);
    }
    
    Serial.println("PMW3901 Initialized");
    display.clearDisplay();
    lastArrow = Start_icon;
    updateDisplay();
}

void loop() {
    int16_t deltaX = 0, deltaY = 0;

    // Read motion data
    flow.readMotionCount(&deltaX, &deltaY);  // Directly updates deltaX & deltaY

    Serial.print("DX: "); Serial.print(deltaX);
    Serial.print(" DY: "); Serial.println(deltaY);

    // Ignore small movements
    if (abs(deltaX) < 3 && abs(deltaY) < 3) {
        return;  // Do not update display if no new movement
    } 

    // Detect only Up, Down, Left, Right
    if (deltaX > 3 && abs(deltaY) < 3) {
        lastMovement = "Right";
        lastArrow = RIGHT_arrow;
    } else if (deltaX < -3 && abs(deltaY) < 3) {
        lastMovement = "Left";
        lastArrow = LEFT_arrow;
    } else if (deltaY > 3 && abs(deltaX) < 3) {
        lastMovement = "UP";
        lastArrow = UP_arrow;
    } else if (deltaY < -3 && abs(deltaX) < 3) {
        lastMovement = "Down";
        lastArrow = DOWN_arrow;
    } else {
        return;  // Ignore diagonal movements
    }

    updateDisplay();  // Update OLED only when movement occurs
}
